# file: VS-N5.ioc
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Mcu.Family=STM32F4
Mcu.Name=STM32F411V(C-E)Tx
Mcu.Package=LQFP100
NVIC.PriorityGroup=NVIC_PRIORITYGROUP_4
ProjectManager.HeapSize=0x200
ProjectManager.StackSize=0x400
ProjectManager.TargetToolchain=STM32CubeIDE
RCC.AHBFreq_Value=16000000
RCC.APB1Freq_Value=16000000
RCC.APB2Freq_Value=16000000
RCC.CortexFreq_Value=16000000
RCC.HSE_VALUE=25000000
RCC.HSI_VALUE=16000000
RCC.LSE_VALUE=32768
RCC.SYSCLKFreq_VALUE=16000000
RCC.VCOOutputFreq_Value=192000000
board=custom

// file: Core/Src/main.c
/* USER CODE BEGIN Header */
/**
  ******************************************************************************
  * @file           : main.c
  * @brief          : Main program body
  ******************************************************************************
  * @attention
  *
  * Copyright (c) 2023 STMicroelectronics.
  * All rights reserved.
  *
  * This software is licensed under terms that can be found in the LICENSE file
  * in the root directory of this software component.
  * If no LICENSE file comes with this software, it is provided AS-IS.
  *
  ******************************************************************************
  */
/* USER CODE END Header */
#include "main.h"

/* USER CODE BEGIN PD */
#define MAX_BRIGHTNESS 100 // Assuming Timer 4 ARR is configured for a max value of 100
/* USER CODE END PD */

/* USER CODE BEGIN PV */
volatile int tick = 0; // This will increment every time TIM3_IRQHandler is called
volatile int led1_brightness = 0;
volatile int led2_brightness = -25; // Offset by 1/4 period
volatile int led3_brightness = -50; // Offset by 1/2 period
/* USER CODE END PV */

void SystemClock_Config(void);
/* USER CODE BEGIN PFP */
void TIM3_IRQHandler(void) {
    if(TIM3->SR & TIM_SR_UIF) {
        // Update brightness for each LED
        led1_brightness = (tick < 50) ? tick * 2 : (100 - tick) * 2;
        led2_brightness = ((tick + 25) % 100 < 50) ? ((tick + 25) % 100) * 2 : (100 - ((tick + 25) % 100)) * 2;
        led3_brightness = ((tick + 50) % 100 < 50) ? ((tick + 50) % 100) * 2 : (100 - ((tick + 50) % 100)) * 2;

        // Update Timer 4 Compare Registers
        TIM4->CCR1 = led1_brightness;
        TIM4->CCR2 = led2_brightness;
        TIM4->CCR3 = led3_brightness;

        tick = (tick + 1) % 100; // Increment
        TIM3->SR &= ~TIM_SR_UIF;
    }
}

/* USER CODE END PFP */

int main(void)
{

  /* MCU Configuration--------------------------------------------------------*/

  /* Reset of all peripherals, Initializes the Flash interface and the Systick. */
  //HAL_Init();

  /* USER CODE BEGIN Init */
	// EN Clock
	RCC->AHB1ENR |= RCC_AHB1ENR_GPIODEN;
	RCC->APB1ENR |= RCC_APB1ENR_TIM4EN;
	RCC->APB1ENR |= RCC_APB1ENR_TIM3EN;

	// GPIOD Pins Alternate Function Mode
	GPIOD->MODER |= 1 << 25;
	GPIOD->MODER |= 1 << 27;
	GPIOD->MODER |= 1 << 29;

	// Alternate Function to AF2 (output PWM)
	GPIOD->AFR[1] |= 2 << 16;
	GPIOD->AFR[1] |= 2 << 20;
	GPIOD->AFR[1] |= 2 << 24;

	// cikel nastavitve
	TIM4->ARR = MAX_BRIGHTNESS - 1;
	TIM4->PSC = 1600 - 1;
	TIM3->ARR = MAX_BRIGHTNESS - 1;
	TIM3->PSC = 1600 - 1;

	//In PWM mode 1, the output pin is set on a timer reset
	// (when the counter is zero) and reset when the
	// counter value matches the CCRx value.

	//In PWM mode 2, the output pin is reset on a timer reset
	// and set when the counter matches the CCRx value

	// Nastavi na PWM mode 2
	TIM4->CCMR1 |= 6 << 4; //PD12
	TIM4->CCMR1 |= 6 << 12; //PD13
	TIM4->CCMR2 |= 6 << 4; //PD14

	// Omogoči output kanale timer4
	TIM4->CCER |= TIM_CCER_CC1E;
	TIM4->CCER |= TIM_CCER_CC2E;
	TIM4->CCER |= TIM_CCER_CC3E;

	// Nastavimo update interrupt in generate interrupts on overflow
	TIM3->DIER |= TIM_DIER_UIE;
	TIM3->CR1 |= TIM_CR1_URS;
	TIM4->DIER |= TIM_DIER_UIE;
	TIM4->CR1 |= TIM_CR1_URS;

	// nastavi interrupt rutino
	NVIC_SetPriority(TIM4_IRQn, 2);
	NVIC_EnableIRQ(TIM4_IRQn);
	NVIC_SetPriority(TIM3_IRQn, 1);
	NVIC_EnableIRQ(TIM3_IRQn);

	// Omogoči ure
	TIM4->CR1 |= TIM_CR1_CEN;
	TIM3->CR1 |= TIM_CR1_CEN;
  /* USER CODE END Init */

  /* Configure the system clock */
  //SystemClock_Config();

  /* Initialize all configured peripherals */

  /* Infinite loop */
  while (1)
  {

  }
}

void SystemClock_Config(void)
{
  RCC_OscInitTypeDef RCC_OscInitStruct = {0};
  RCC_ClkInitTypeDef RCC_ClkInitStruct = {0};

  /** Configure the main internal regulator output voltage
  */
  __HAL_RCC_PWR_CLK_ENABLE();
  __HAL_PWR_VOLTAGESCALING_CONFIG(PWR_REGULATOR_VOLTAGE_SCALE1);

  /** Initializes the RCC Oscillators according to the specified parameters
  * in the RCC_OscInitTypeDef structure.
  */
  RCC_OscInitStruct.OscillatorType = RCC_OSCILLATORTYPE_HSI;
  RCC_OscInitStruct.HSIState = RCC_HSI_ON;
  RCC_OscInitStruct.HSICalibrationValue = RCC_HSICALIBRATION_DEFAULT;
  RCC_OscInitStruct.PLL.PLLState = RCC_PLL_NONE;
  if (HAL_RCC_OscConfig(&RCC_OscInitStruct) != HAL_OK)
  {
    Error_Handler();
  }

  /** Initializes the CPU, AHB and APB buses clocks
  */
  RCC_ClkInitStruct.ClockType = RCC_CLOCKTYPE_HCLK|RCC_CLOCKTYPE_SYSCLK
                              |RCC_CLOCKTYPE_PCLK1|RCC_CLOCKTYPE_PCLK2;
  RCC_ClkInitStruct.SYSCLKSource = RCC_SYSCLKSOURCE_HSI;
  RCC_ClkInitStruct.AHBCLKDivider = RCC_SYSCLK_DIV1;
  RCC_ClkInitStruct.APB1CLKDivider = RCC_HCLK_DIV1;
  RCC_ClkInitStruct.APB2CLKDivider = RCC_HCLK_DIV1;

  if (HAL_RCC_ClockConfig(&RCC_ClkInitStruct, FLASH_LATENCY_0) != HAL_OK)
  {
    Error_Handler();
  }
}

void Error_Handler(void)
{
  __disable_irq();
  while (1)
  {
  }
}
